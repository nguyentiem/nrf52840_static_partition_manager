## boards/arm/custom_nrf52840/Kconfig.board
```kconfig
# Copyright (c) 2023 Nordic Semiconductor ASA
# SPDX-License-Identifier: Apache-2.0

config BOARD_CUSTOM_NRF52840
	bool "Custom NRF52840"
	depends on SOC_NRF52840_QIAA
```
